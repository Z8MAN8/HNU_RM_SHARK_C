## board/Kconfig
```kconfig
menu "Hardware Drivers Config"

config SOC_STM32F407IG
    bool
    select SOC_SERIES_STM32F4
    select RT_USING_COMPONENTS_INIT
    select RT_USING_USER_MAIN
    default y

menu "Onboard Peripheral Drivers"

    config BSP_USING_ARDUINO
        bool "Compatible with Arduino Ecosystem (RTduino)"
        select PKG_USING_RTDUINO
        select BSP_USING_STLINK_TO_USART
        select BSP_USING_GPIO
        select BSP_USING_ADC
        select BSP_USING_ADC1
        select BSP_USING_PWM
        select BSP_USING_PWM1
        select BSP_USING_PWM1_CH1
        select BSP_USING_PWM1_CH2
        select BSP_USING_PWM1_CH3
        select BSP_USING_PWM1_CH4
        select BSP_USING_PWM8
        select BSP_USING_PWM8_CH1
        select BSP_USING_PWM8_CH2
        select BSP_USING_PWM8_CH3
        select BSP_USING_I2C
        select BSP_USING_I2C1
        imply RTDUINO_USING_SERVO
        imply RTDUINO_USING_WIRE
        default n

endmenu

menu "On-chip Peripheral Drivers"

    config BSP_USING_GPIO
        bool "Enable GPIO"
        select RT_USING_PIN
        default y

    menuconfig BSP_USING_UART
        bool "Enable UART"
        default y
        select RT_USING_SERIAL
        if BSP_USING_UART
            config BSP_USING_UART1
                bool "Enable UART1 (FinSH , symbol UART2 on board)"
                default y
            config BSP_UART1_RX_USING_DMA
                bool "Enable UART1 RX DMA"
                depends on BSP_USING_UART1 && RT_SERIAL_USING_DMA
                default n
            config BSP_UART1_RX_BUFSIZE
                int "Set UART1 RX buffer size"
                range 64 65535
                depends on RT_USING_SERIAL_V2
                default 256
            config BSP_UART1_TX_BUFSIZE
                int "Set UART1 TX buffer size"
                range 0 65535
                depends on RT_USING_SERIAL_V2
                default 0

            config BSP_USING_UART3
                bool "Enable UART3 (DBUS)"
                default n
            config BSP_UART3_RX_USING_DMA
                bool "Enable UART3 RX DMA"
                depends on BSP_USING_UART3 && RT_SERIAL_USING_DMA
                default n
            config BSP_UART3_RX_BUFSIZE
                int "Set UART3 RX buffer size"
                range 64 65535
                depends on RT_USING_SERIAL_V2
                default 256
            config BSP_UART3_TX_BUFSIZE
                int "Set UART3 TX buffer size"
                range 0 65535
                depends on RT_USING_SERIAL_V2
                default 0

            config BSP_USING_UART6
                bool "Enable UART6"
                default n
            config BSP_UART6_RX_USING_DMA
                bool "Enable UART6 RX DMA"
                depends on BSP_USING_UART6 && RT_SERIAL_USING_DMA
                default n
            config BSP_UART6_RX_BUFSIZE
                int "Set UART6 RX buffer size"
                range 64 65535
                depends on RT_USING_SERIAL_V2
                default 256
            config BSP_UART6_TX_BUFSIZE
                int "Set UART6 TX buffer size"
                range 0 65535
                depends on RT_USING_SERIAL_V2
                default 0

        endif

    menuconfig BSP_USING_CAN
        bool "Enable CAN"
        default n
        select RT_USING_CAN
        if BSP_USING_CAN
            config BSP_USING_CAN1
                bool "using CAN1 (2pin)"
                default n
            config BSP_USING_CAN2
                bool "using CAN2 (4pin)"
                default n
        endif

    menuconfig BSP_USING_TIM
            bool "Enable timer"
            default n
            select RT_USING_HWTIMER
            if BSP_USING_TIM
                config BSP_USING_TIM0
                    bool "Enable TIM0"
                    default n
                config BSP_USING_TIM1
                    bool "Enable TIM1"
                    default n
                config BSP_USING_TIM4
                    bool "Enable TIM4"
                    default n
            endif

    menuconfig BSP_USING_PWM
        bool "Enable PWM"
        default n
        select RT_USING_PWM
        if BSP_USING_PWM

            menuconfig BSP_USING_PWM1
                bool "Enable timer1 output PWM"
                default n
                if BSP_USING_PWM1
                    config BSP_USING_PWM1_CH1
                        bool "Enable PWM1 channel1"
                        default n
                    config BSP_USING_PWM1_CH2
                        bool "Enable PWM1 channel2"
                        default n
                    config BSP_USING_PWM1_CH3
                        bool "Enable PWM1 channel3"
                        default n
                    config BSP_USING_PWM1_CH4
                        bool "Enable PWM1 channel4"
                        default n
                endif

            menuconfig BSP_USING_PWM4
                bool "Enable timer4 output PWM"
                default n
                if BSP_USING_PWM4
                    config BSP_USING_PWM4_CH3
                        bool "Enable PWM4 channel3 (buzzer)"
                        default n
                endif

            menuconfig BSP_USING_PWM5
                bool "Enable timer5 output PWM"
                default n
                if BSP_USING_PWM5
                    config BSP_USING_PWM5_CH1
                        bool "Enable PWM5 channel1(LED_B)"
                        default n
                    config BSP_USING_PWM5_CH2
                        bool "Enable PWM5 channel2(LED_G)"
                        default n
                    config BSP_USING_PWM5_CH3
                        bool "Enable PWM5 channel3(LED_R)"
                        default n
                endif

            menuconfig BSP_USING_PWM8
                bool "Enable timer8 output PWM"
                default n
                if BSP_USING_PWM8
                    config BSP_USING_PWM8_CH1
                        bool "Enable PWM8 channel1"
                        default n
                    config BSP_USING_PWM8_CH2
                        bool "Enable PWM8 channel2"
                        default n
                    config BSP_USING_PWM8_CH3
                        bool "Enable PWM8 channel3"
                        default n
                endif

            menuconfig BSP_USING_PWM10
                bool "Enable timer10 output PWM"
                default n
                if BSP_USING_PWM10
                    config BSP_USING_PWM10_CH1
                        bool "Enable PWM10 channel1 (imu)"
                        default n
                endif

        endif

    menuconfig BSP_USING_ADC
        bool "Enable ADC"
        default n
        select RT_USING_ADC
        if BSP_USING_ADC
            config BSP_USING_ADC1
                bool "Enable ADC1"
                default n
            config BSP_USING_ADC3
                bool "Enable ADC3"
                default n
        endif

    menuconfig BSP_USING_SPI
        bool "Enable SPI BUS"
        default n
        select RT_USING_SPI
        if BSP_USING_SPI
            config BSP_USING_SPI1
                bool "Enable SPI1 BUS"
                default n

            config BSP_SPI1_TX_USING_DMA
                bool "Enable SPI1 TX DMA"
                depends on BSP_USING_SPI1
                default n

            config BSP_SPI1_RX_USING_DMA
                bool "Enable SPI1 RX DMA"
                depends on BSP_USING_SPI1
                select BSP_SPI1_TX_USING_DMA
                default n

            config BSP_USING_SPI2
                bool "Enable SPI2 BUS"
                default n

            config BSP_SPI2_TX_USING_DMA
                bool "Enable SPI2 TX DMA"
                depends on BSP_USING_SPI2
                default n

            config BSP_SPI2_RX_USING_DMA
                bool "Enable SPI2 RX DMA"
                depends on BSP_USING_SPI2
                select BSP_SPI2_TX_USING_DMA
                default n
        endif

    menuconfig BSP_USING_I2C1
        bool "Enable I2C1 BUS (software simulation)"
        default n
        select RT_USING_I2C
        select RT_USING_I2C_BITOPS
        select RT_USING_PIN
        if BSP_USING_I2C1
            comment "Notice: PA8 --> 8; PC9 --> 41"
            config BSP_I2C1_SCL_PIN
                int "i2c1 scl pin number"
                default 8
            config BSP_I2C1_SDA_PIN
                int "I2C1 sda pin number"
                default 41
        endif

    menuconfig BSP_USING_USBD
		bool "Enable USB"
		default y

    source "libraries/HAL_Drivers/Kconfig"

endmenu

menu "RoboMaster Modules"
    menuconfig BSP_USING_MOTOR
        bool "Select USING Motors"
        default y
        if BSP_USING_MOTOR
            config BSP_USING_DJI_MOTOR
                bool "Using DJI Motors"
                default y

            config BSP_USING_HT_MOTOR
                bool "Using HT Motors"
                default n

            config BSP_USING_LK_MOTOR
                bool "Using LK Motors"
                default n
        endif

    config BSP_USING_DWT
        bool "Enable DWT"
        default y

    config BSP_USING_PS_MSG
        bool "Enable Pub Sub Message"
        default y

    menuconfig BSP_USING_MAG
        bool "Enable Magnetometer"
        default y
        if BSP_USING_MAG
            config BSP_USING_IST8310
                bool "Using IST8310"
                default y
        endif

    menuconfig BSP_USING_IMU
        bool "Enable IMU"
        default y
        if BSP_USING_IMU
            config BSP_USING_BMI088
                bool "Using BMI088"
                default y
                if BSP_USING_BMI088
                    config BSP_BMI088_CALI
                    bool "Calibrate BMI088 (Get more info in BMI088 README)"
                    default n
                endif
        endif
    
    config BSP_USING_RC_SBUS
        bool "Enable RC SBUS"
        default n

    config BSP_USING_RC_DBUS
        bool "Enable RC DBUS"
        default y

    config BSP_USING_RC_KEYBOARD
        bool "Enable RC KEYBOARD"
        default y

    config BSP_USING_REFEREE
        bool "Enable REFEREE"
        default y

    config BSP_USING_LEG
        bool "Enable Leg Solve"
        default n

endmenu

menu "RoboMaster Algorithms"
    config BSP_USING_PID
        bool "Select USING PID Controller"
        default y

    config BSP_USING_QUATERNIONESF
       bool "Select USING QuaternionEKF"
       default y
       select BSP_USING_KALMAN_FILTER

    config BSP_USING_FILTER
       bool "Select USING Filter"
       default y

    config BSP_USING_KALMAN_FILTER
       bool "Select USING KalmanFilter"
       default y

    config BSP_USING_RAMP
       bool "Select USING Ramp"
       default y

endmenu

menu "RoboMaster Tasks"
    config BSP_USING_EXAMPLE_TASK
        bool "Select USING Example Task"
        default n

    config BSP_USING_INS_TASK
        bool "Select USING Ins Task"
        default y

    config BSP_USING_MOTOR_TASK
        bool "Select USING Motor Task"
        default y

    config BSP_USING_CMD_TASK
        bool "Select USING Cmd Task"
        default y

    menuconfig BSP_USING_CHASSIS_TASK
        bool "Select USING Chassis Task"
        default y
        if BSP_USING_CHASSIS_TASK
            config BSP_CHASSIS_OMNI_MODE
                bool "Select Chassis Omni Mode"
                default y
            config BSP_CHASSIS_MECANUM_MODE
                bool "Select Chassis Mecanum Mode"
                default n
        endif
    
    config BSP_USING_GIMBAL_TASK
        bool "Select USING Gimbal Task"
        default y

    config BSP_USING_TRANSMISSION_TASK
        bool "Select USING Transmission Task"
        default y

    config BSP_USING_SHOOT_TASK
        bool "Select USING Shoot Task"
        default y

    config BSP_USING_REFEREE_TASK
            bool "Select USING Referee Task"
            default y

endmenu

menu "RoboMaster Robot Types"
    config WHEEL_LEG_INFANTRY
        bool "Select Wheel Leg Infantry"
        default n
        select BSP_USING_LEG
        select BSP_USING_MOTOR
        select BSP_USING_RC_SBUS
        select BSP_USING_PID
        select BSP_USING_KALMAN_FILTER
        select BSP_USING_INS_TASK
        select BSP_USING_MOTOR_TASK
        select BSP_USING_CMD_TASK

endmenu

menu "Board extended module Drivers"

endmenu

endmenu
```
